#include <avr/io.h>
#include <avr/pgmspace.h>
#include <avr/interrupt.h>
#define max_size    14736  
//应该是保存在flash中
const unsigned char data[max_size] PROGMEM = { 
  0x7D, 0x7D, 0x82, 0x87, 0x84, 0x80, 0x81, 0x80, 0x7E, 0x7B, 0x7A, 0x7F, 0x7E, 0x7F, 0x83, 0x86, 
  0x81, 0x80, 0x81, 0x83, 0x80, 0x7F, 0x7F, 0x80, 0x7E, 0x7F, 0x83, 0x82, 0x7F, 0x7E, 0x80, 0x81, 
  0x80, 0x80, 0x80, 0x7F, 0x7B, 0x7E, 0x80, 0x80, 0x7E, 0x7E, 0x80, 0x81, 0x81, 0x84, 0x84, 0x81, 
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  0x78, 0x74, 0x76, 0x74, 0x79, 0x7C, 0x7C, 0x80, 0x82, 0x85, 0x86, 0x88, 0x86, 0x87, 0x86, 0x87 
};  //采样频率 8K，分辨率 8位的“会说话的单片机(带背静音乐)”WAVE数据 
 
#define true    1 
#define false   !true 
 
volatile unsigned char  key_s_ok,play_on; 
unsigned int index; 
// Timer2 output compare interrupt service routine 
// 8K 中断,间隔 125us,为 1000 个指令周期 

ISR(TIMER2_COMPA_vect)
{ 
    if(play_on) 
    { 
        OCR0A =pgm_read_byte(&data[index]); 
        if(++index > max_size) 
        {    
            
      //TCCR0 &= 0xf8;//停止PWM输出 
      TCCR0B = 0x00;
      OCR0A = 0x7F; 
            play_on = false; 
        }     
    } 
    key_s_ok = true; 
} 
 
#define key_input  (PINC&0x02) // 按键输入口 
#define key_state_0 0 
#define key_state_1 1 
#define key_state_2 2 
  
unsigned char read_key(void) 
{ 
  static unsigned char key_state = 0; 
  unsigned char key_press, key_return = 0; 
  key_press = key_input;        // 读按键 I/O 电平 
  switch (key_state) 
  { 
    case key_state_0:           // 按键初始态 
      if (!key_press) key_state = key_state_1; 
      break; 
    case key_state_1:           // 按键确认态 
      if (!key_press) 
      { 
        key_return = 1;     // 按键仍按下，按键确认输出为"1" 
        key_state = key_state_2;  // 状态转换到键释放态 
      } 
      else 
        key_state = key_state_0;  // 按键已抬起，转换到按键初始态 
      break; 
    case key_state_2: 
      if (key_press) key_state = key_state_0;  
      break; 
    }   
      return key_return; 
}

unsigned char scan_key = 0; 
void setup() {     
 
    //DDRB=0x08;          // PB3 输出方式，作为 OC0 输出 PWM 波 
  //DDRD = 0x60;    //PD 5-6
  DDRD = 0x40;
    PORTC|=0x02;        // 按键输入口，内部上拉电阻有效 PC5
 
  // T/C0 initialization 
  // Clock source: System Clock,Clock value: 8000.000 kHz 
  // Mode: Fast PWM top=FFh,OC0 output: Non-Inverted PWM 
  // PWM 频率 8000000/256 = 31.25KHz 
  //mega328p
  //CLKPR = 0x81;
  CLKPR=0x80;
  CLKPR=0x01;
  TCCR0A = 0x83;
  TCNT0 = 0x00;
  OCR0A = 0x7F;
  // T/C2 initialization 
  // Clock source: System Clock,Clock value: 1000.000 kHz 
  // Mode: CTC top=OCR2,OC2 output: Disconnected 
  ASSR=0x00; 
  //mega328p
  TCCR2A = 0x02;
  TCCR2B = 0x02;
  OCR2A = 0x7C;
  TIMSK2 = 0x02;
  //TIMSK=0x80;             // 允许 T/2 比较匹配中断
  //play_on = true;         // 启动 1 次播放音频 
  sei();    // 开放全局中断 
  // 主循环 
}

void loop() {
      if(key_s_ok) 
      { 
          key_s_ok = false; 
          if(++scan_key >= 159)   //20ms 扫描按键 
          {   
              scan_key = 0; 
              if(read_key()) 
              { 
                  if(!play_on) 
                  { 
                      index = 0; 
            //TCCR0=0x69;//启动PWM
            TCCR0B = 0x01;
                      play_on = true;  // 启动 1次播放音频 
                  }             
              } 
          }     
      } 
}
